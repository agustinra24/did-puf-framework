## firmware/root_of_trust_fw/sdkconfig.defaults
```kconfig
# Root of Trust — Firmware Funcional v4
CONFIG_PARTITION_TABLE_CUSTOM=y
CONFIG_PARTITION_TABLE_CUSTOM_FILENAME="partitions.csv"
CONFIG_ESP_HTTP_CLIENT_ENABLE_HTTPS=n
CONFIG_LOG_DEFAULT_LEVEL_INFO=y
CONFIG_LOG_DEFAULT_LEVEL=3
CONFIG_ESP_MAIN_TASK_STACK_SIZE=12288
CONFIG_NVS_ENCRYPTION=n
CONFIG_ESPTOOLPY_FLASHSIZE_4MB=y
CONFIG_ESP_DEFAULT_CPU_FREQ_MHZ_240=y
```
